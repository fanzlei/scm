/*
标题：蜂鸣器播放音乐
电路：p2.1口接P11

*/


#include <reg52.h>
#include "beep3.h"
#include "sys.h"

//八月桂花
unsigned char code music_code[] ={   
0x18, 0x30, 0x1C , 0x10, //格式为：频率常数、节拍常数、频率常数、节拍常数   
0x20, 0x40, 0x1C , 0x10,   
0x18, 0x10, 0x20 , 0x10,   
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0x18, 0x80, 0x00   
};   

unsigned char* pin;//频率
unsigned char* pai;//节拍
sbit beez = P2^1;

void beep3(){
	int i,j;
	play:
	pin = music_code;
	pai = pin+1;
	beez = 0;
	while(1){
		if(pin == 0x00){
			//遇到结束符
			goto play;
		}
		if(pai == 0xff){
			//遇到休止符,等待一段时间
			delays(200000);
		}
		for(i=0;i<(*pai)*10;i++){
			
			for(j=0;j<(*pin);j++){
				beez = ~beez;
			}
		}
		pin += 2;
		pai += 2;
		
	}

}